## conf/layer.conf
```bitbake
# We have a conf and classes directory, add to BBPATH
BBPATH .= ":${LAYERDIR}"

# We have recipes-* directories, add to BBFILES
BBFILES += "${LAYERDIR}/recipes-*/*/*.bb \
            ${LAYERDIR}/recipes-*/*/*.bbappend"

BBFILE_COLLECTIONS += "meta-efficios"
BBFILE_PATTERN_meta-efficios = "^${LAYERDIR}/"
BBFILE_PRIORITY_meta-efficios = "6"

LAYERDEPENDS_meta-efficios = "core"
LAYERSERIES_COMPAT_meta-efficios = "hardknott"
```
